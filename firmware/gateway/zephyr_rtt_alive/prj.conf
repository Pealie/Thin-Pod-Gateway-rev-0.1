## CMakeLists.txt
```
cmake_minimum_required(VERSION 3.20.0)

find_package(Zephyr REQUIRED HINTS $ENV{ZEPHYR_BASE})
project(thinpod_gateway_rtt_alive)

target_sources(app PRIVATE src/main.c)
```

## prj.conf
```kconfig
CONFIG_PRINTK=y
CONFIG_CONSOLE=y

CONFIG_USE_SEGGER_RTT=y
CONFIG_RTT_CONSOLE=y

CONFIG_UART_CONSOLE=n
CONFIG_LOG=n
```

## src/main.c
```c
#include <zephyr/kernel.h>
#include <zephyr/sys/printk.h>

int main(void)
{
    int tick = 1;

    printk("\n\nThin-Pod Gateway CDK alive\n");

    while (1) {
        printk("gateway tick %d\n", tick++);
        k_sleep(K_SECONDS(1));
    }

    return 0;
}
```
