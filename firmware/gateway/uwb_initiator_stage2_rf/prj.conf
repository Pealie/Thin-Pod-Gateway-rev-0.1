## CMakeLists.txt
```
cmake_minimum_required(VERSION 3.20.0)

find_package(Zephyr REQUIRED HINTS $ENV{ZEPHYR_BASE})
project(thinpod_gateway_uwb_initiator_stage2_rf)

target_sources(app PRIVATE
    src/main.c
    ../../common/thinpod_protocol/thinpod_protocol.c
)

target_include_directories(app PRIVATE
    ../../common/thinpod_protocol
)

add_subdirectory(
    ../../common/qorvo_dw3000
    ${CMAKE_CURRENT_BINARY_DIR}/qorvo_dw3000
)
```

## prj.conf
```kconfig
CONFIG_PRINTK=y
CONFIG_CONSOLE=y

CONFIG_USE_SEGGER_RTT=y
CONFIG_RTT_CONSOLE=y

CONFIG_UART_CONSOLE=n
CONFIG_LOG=n

# Qorvo DW3000/DW3110 external-driver integration
CONFIG_SPI=y
CONFIG_GPIO=y
CONFIG_MAIN_STACK_SIZE=4096
```

## dts/bindings/uwb/qorvo,dw3000.yaml
```yaml
description: |
  Qorvo DW3000 and DW3110 ultra-wideband transceiver.

compatible: "qorvo,dw3000"

include: spi-device.yaml
```

## src/main.c
```c
#include <zephyr/kernel.h>
#include <zephyr/sys/printk.h>

#include "thinpod_dw3000_platform.h"
#include "thinpod_dw3000_rf_proof.h"
#include "thinpod_protocol.h"

int main(void)
{
    int rc;

    printk("\n\n");
    printk("Thin-Pod Gateway-side DWM3001-CDK one-way DW3110 RF proof\n");
    printk("role=gateway role_id=0x%04x direction=gateway-to-node proof=one-way-rf-frame-v1\n",
           THINPOD_GATEWAY_ID);
    printk("driver=%s\n", thinpod_dw3000_driver_version());

    rc = thinpod_dw3000_rf_prepare(
        "gateway",
        THINPOD_GATEWAY_ID);

    if (rc != 0) {
        printk("TPRF_FATAL role=gateway stage=prepare rc=%d result=FAIL\n",
               rc);
        while (1) {
            k_sleep(K_SECONDS(5));
        }
    }

    printk("TPRF_READY role=gateway mode=tx src=0x%04x dst=0x%04x interval_ms=500 suite_frames=%u\n",
           THINPOD_GATEWAY_ID,
           THINPOD_NODE_ID,
           THINPOD_RF_PROOF_SUITE_FRAMES);

    thinpod_dw3000_rf_run_transmitter(
        "gateway",
        THINPOD_GATEWAY_ID,
        THINPOD_NODE_ID);

    return 0;
}
```
